## CMakeLists.txt
```
cmake_minimum_required(VERSION 3.20.0)

find_package(Zephyr REQUIRED HINTS $ENV{ZEPHYR_BASE})
project(micro_speech_xiao)

# These samples use local static initialization. Since Zephyr doesn't support the
# C++ ABI for thread-safe initialization of local statics and the constructors don't
# appear to require thread safety, we turn it off in the C++ compiler.
set(NO_THREADSAFE_STATICS $<TARGET_PROPERTY:compiler-cpp,no_threadsafe_statics>)
zephyr_compile_options($<$<COMPILE_LANGUAGE:CXX>:${NO_THREADSAFE_STATICS}>)

# Paths
set(OPTIONAL_TFLITE_DIR $ENV{ZEPHYR_BASE}/../optional/modules/lib/tflite-micro/signal)

# Model selection: pass -DMICRO_SPEECH_FLOAT_PREPROCESSOR=y to use float32
# audio preprocessor instead of the default INT8 quantized one.
if(MICRO_SPEECH_FLOAT_PREPROCESSOR)
  message(STATUS "micro_speech_xiao: preprocessor = float32")
  zephyr_compile_definitions(MICRO_SPEECH_FLOAT_PREPROCESSOR=1)
else()
  message(STATUS "micro_speech_xiao: preprocessor = INT8 quantized (default)")
endif()

file(GLOB app_sources src/*.cpp src/*.c)

target_include_directories(
  app
  PRIVATE
  src
  ${ZEPHYR_TFLITE_MICRO_MODULE_DIR}/signal
  ${ZEPHYR_TFLITE_MICRO_MODULE_DIR}/signal/micro/kernels/
  ${ZEPHYR_TFLITE_MICRO_MODULE_DIR}/signal/src
)

target_sources(
  app
  PRIVATE
  ${app_sources}

  # Signal processing
  ${OPTIONAL_TFLITE_DIR}/src/fft_auto_scale.cc
  ${OPTIONAL_TFLITE_DIR}/src/max_abs.cc
  ${OPTIONAL_TFLITE_DIR}/src/msb_32.cc
  ${OPTIONAL_TFLITE_DIR}/src/energy.cc
  ${OPTIONAL_TFLITE_DIR}/src/filter_bank.cc
  ${OPTIONAL_TFLITE_DIR}/src/filter_bank_square_root.cc
  ${OPTIONAL_TFLITE_DIR}/src/square_root_64.cc
  ${OPTIONAL_TFLITE_DIR}/src/square_root_32.cc
  ${OPTIONAL_TFLITE_DIR}/src/msb_64.cc
  ${OPTIONAL_TFLITE_DIR}/src/pcan_argc_fixed.cc
  ${OPTIONAL_TFLITE_DIR}/src/filter_bank_log.cc
  ${OPTIONAL_TFLITE_DIR}/src/log.cc
  ${OPTIONAL_TFLITE_DIR}/src/filter_bank_spectral_subtraction.cc

  # Micro kernels
  ${OPTIONAL_TFLITE_DIR}/micro/kernels/energy.cc
  ${OPTIONAL_TFLITE_DIR}/micro/kernels/fft_auto_scale_common.cc
  ${OPTIONAL_TFLITE_DIR}/micro/kernels/fft_auto_scale_kernel.cc
  ${OPTIONAL_TFLITE_DIR}/micro/kernels/filter_bank_square_root_common.cc
  ${OPTIONAL_TFLITE_DIR}/micro/kernels/filter_bank_square_root.cc
  ${OPTIONAL_TFLITE_DIR}/micro/kernels/filter_bank_spectral_subtraction.cc
  ${OPTIONAL_TFLITE_DIR}/micro/kernels/filter_bank.cc
  ${OPTIONAL_TFLITE_DIR}/micro/kernels/pcan.cc
  ${OPTIONAL_TFLITE_DIR}/micro/kernels/filter_bank_log.cc
)
```

## sample.yaml
```
sample:
  description: Micro Speech sample for Seeed XIAO BLE Sense (nRF52840) using onboard PDM microphone
  name: micro speech xiao
common:
  tags:
    - tensorflow
    - audio
    - ml
  build_only: true
  modules:
    - tflite-micro
  harness: console
  harness_config:
    type: multi_line
    ordered: false
    regex:
      - "Detected: (yes|no|silence|unknown)"
tests:
  sample.tensorflow.micro_speech_xiao:
    integration_platforms:
      - xiao_ble/nrf52840/sense
    platform_allow:
      - xiao_ble/nrf52840/sense
```

## prj.conf
```kconfig
# TFLite Micro
CONFIG_CPP=y
CONFIG_STD_CPP17=y
CONFIG_TENSORFLOW_LITE_MICRO=y
# stack size needed to safely initialize
# and run TensorFlow Lite Micro operations
# in the main thread
CONFIG_MAIN_STACK_SIZE=6144
CONFIG_REQUIRES_FLOAT_PRINTF=y

# PDM microphone via Zephyr audio/dmic API
CONFIG_AUDIO=y
CONFIG_AUDIO_DMIC=y

# USB CDC ACM for serial output (same as hello_world setup)
CONFIG_USB_DEVICE_STACK_NEXT=y
CONFIG_USBD_CDC_ACM_CLASS=y
CONFIG_UART_LINE_CTRL=y

# Logging
CONFIG_LOG=y
CONFIG_LOG_DEFAULT_LEVEL=3
CONFIG_PRINTK=y
```

## boards/xiao_ble_nrf52840_sense.overlay
```dts
/*
 * Copyright 2025 The TensorFlow Authors. All Rights Reserved.
 *
 * SPDX-License-Identifier: Apache-2.0
 */

/*
 * Enable the onboard PDM microphone (MSM261D3526HICPM-C).
 * Pinctrl (PDM_CLK=P1.00, PDM_DIN=P0.16) and clock-source are already
 * defined in the board DTS; we only need to mark the peripheral as okay
 * and expose it under the "dmic_dev" label used by the audio driver API.
 */
dmic_dev: &pdm0 {
	status = "okay";
};
```

## src/main.cpp
```c
/*
 * Copyright 2025 The TensorFlow Authors. All Rights Reserved.
 *
 * Licensed under the Apache License, Version 2.0 (the "License");
 * you may not use this file except in compliance with the License.
 * You may obtain a copy of the License at
 *
 *     http://www.apache.org/licenses/LICENSE-2.0
 *
 * Unless required by applicable law or agreed to in writing, software
 * distributed under the License is distributed on an "AS IS" BASIS,
 * WITHOUT WARRANTIES OR CONDITIONS OF ANY KIND, either express or implied.
 * See the License for the specific language governing permissions and
 * limitations under the License.
 *
 * SPDX-License-Identifier: Apache-2.0
 */

#include "main_functions.hpp"

int main(int argc, char *argv[])
{
	setup();
	while (1) {
		loop();
	}
	return 0;
}
```

## src/model_runner.cpp
```c
/*
 * Copyright 2025 The TensorFlow Authors. All Rights Reserved.
 *
 * Licensed under the Apache License, Version 2.0 (the "License");
 * you may not use this file except in compliance with the License.
 * You may obtain a copy of the License at
 *
 *     http://www.apache.org/licenses/LICENSE-2.0
 *
 * Unless required by applicable law or agreed to in writing, software
 * distributed under the License is distributed on an "AS IS" BASIS,
 * WITHOUT WARRANTIES OR CONDITIONS OF ANY KIND, either express or implied.
 * See the License for the specific language governing permissions and
 * limitations under the License.
 *
 * SPDX-License-Identifier: Apache-2.0
 */

#include "model_runner.h"

#include <zephyr/logging/log.h>
LOG_MODULE_REGISTER(model_runner);

#include "tensorflow/lite/core/c/common.h"
#include "tensorflow/lite/micro/micro_interpreter.h"
#include "tensorflow/lite/micro/micro_log.h"
#include "tensorflow/lite/micro/micro_mutable_op_resolver.h"

/*
 * Model selection via CMake variable (set in CMakeLists.txt):
 *   -DMICRO_SPEECH_FLOAT_PREPROCESSOR=y  → float32 audio preprocessor
 *   (default)                            → INT8  audio preprocessor
 * The keyword classifier is always INT8 quantized.
 */
#if defined(MICRO_SPEECH_FLOAT_PREPROCESSOR)
#include "audio_preprocessor_float_model.hpp"
#define g_audio_preprocessor_model_data g_audio_preprocessor_float_model
#else
#include "audio_preprocessor_int8_model.hpp"
#define g_audio_preprocessor_model_data g_audio_preprocessor_int8_model
#endif

#include "micro_speech_quantized_model.hpp"
#include "micro_model_settings.h"

#include <zephyr/kernel.h>
#include <algorithm>
#include <string.h>
#include <math.h>

/* -----------------------------------------------------------------------
 * Type aliases
 * ----------------------------------------------------------------------- */
using MicroSpeechOpResolver    = tflite::MicroMutableOpResolver<4>;
using AudioPreprocessorOpResolver = tflite::MicroMutableOpResolver<18>;

using Features = int8_t[kFeatureCount][kFeatureSize];

/* -----------------------------------------------------------------------
 * Tensor arenas
 * ----------------------------------------------------------------------- */
namespace {

#if defined(MICRO_SPEECH_FLOAT_PREPROCESSOR)
constexpr size_t kAudioPreprocessorArenaSize = 32768; /* ~32 KB for float32 ops */
#else
constexpr size_t kAudioPreprocessorArenaSize = 16384; /* ~16 KB for INT8 ops */
#endif
constexpr size_t kMicroSpeechArenaSize       = 12200; /* ~12 KB */

alignas(16) uint8_t g_audio_preprocessor_arena[kAudioPreprocessorArenaSize];
alignas(16) uint8_t g_micro_speech_arena[kMicroSpeechArenaSize];

/* Derived sample counts */
constexpr int kAudioSampleDurationCount =
	kFeatureDurationMs * kAudioSampleFrequency / 1000;
constexpr int kAudioSampleStrideCount =
	kFeatureStrideMs * kAudioSampleFrequency / 1000;

/* Static interpreters – allocated once */
static const tflite::Model *g_audio_preprocessor_model;
static const tflite::Model *g_micro_speech_model;
static AudioPreprocessorOpResolver *g_audio_preprocessor_op_resolver;
static MicroSpeechOpResolver       *g_micro_speech_op_resolver;
static tflite::MicroInterpreter    *g_audio_preprocessor_interpreter;
static tflite::MicroInterpreter    *g_micro_speech_interpreter;
static bool g_initialized;

/* Feature buffer */
static Features g_features;

/* -----------------------------------------------------------------------
 * Op registration helpers
 * ----------------------------------------------------------------------- */
static TfLiteStatus register_micro_speech_ops(MicroSpeechOpResolver &r)
{
	TF_LITE_ENSURE_STATUS(r.AddReshape());
	TF_LITE_ENSURE_STATUS(r.AddFullyConnected());
	TF_LITE_ENSURE_STATUS(r.AddDepthwiseConv2D());
	TF_LITE_ENSURE_STATUS(r.AddSoftmax());
	return kTfLiteOk;
}

static TfLiteStatus register_audio_preprocessor_ops(AudioPreprocessorOpResolver &r)
{
	TF_LITE_ENSURE_STATUS(r.AddReshape());
	TF_LITE_ENSURE_STATUS(r.AddCast());
	TF_LITE_ENSURE_STATUS(r.AddStridedSlice());
	TF_LITE_ENSURE_STATUS(r.AddConcatenation());
	TF_LITE_ENSURE_STATUS(r.AddMul());
	TF_LITE_ENSURE_STATUS(r.AddAdd());
	TF_LITE_ENSURE_STATUS(r.AddDiv());
	TF_LITE_ENSURE_STATUS(r.AddMinimum());
	TF_LITE_ENSURE_STATUS(r.AddMaximum());
	TF_LITE_ENSURE_STATUS(r.AddWindow());
	TF_LITE_ENSURE_STATUS(r.AddFftAutoScale());
	TF_LITE_ENSURE_STATUS(r.AddRfft());
	TF_LITE_ENSURE_STATUS(r.AddEnergy());
	TF_LITE_ENSURE_STATUS(r.AddFilterBank());
	TF_LITE_ENSURE_STATUS(r.AddFilterBankSquareRoot());
	TF_LITE_ENSURE_STATUS(r.AddFilterBankSpectralSubtraction());
	TF_LITE_ENSURE_STATUS(r.AddPCAN());
	TF_LITE_ENSURE_STATUS(r.AddFilterBankLog());
	return kTfLiteOk;
}

/* -----------------------------------------------------------------------
 * Interpreter initialisation
 * ----------------------------------------------------------------------- */
static TfLiteStatus initialize_interpreters(void)
{
	if (g_initialized) {
		return kTfLiteOk;
	}

#if defined(MICRO_SPEECH_FLOAT_PREPROCESSOR)
	LOG_INF("Initializing TFLM interpreters [preprocessor: float32]");
#else
	LOG_INF("Initializing TFLM interpreters [preprocessor: INT8 quantized]");
#endif

	/* Audio preprocessor */
	g_audio_preprocessor_model =
		tflite::GetModel(g_audio_preprocessor_model_data);
	if (g_audio_preprocessor_model->version() != TFLITE_SCHEMA_VERSION) {
		LOG_ERR("Audio preprocessor model schema mismatch");
		return kTfLiteError;
	}

	static AudioPreprocessorOpResolver audio_preprocessor_op_resolver;
	g_audio_preprocessor_op_resolver = &audio_preprocessor_op_resolver;
	if (register_audio_preprocessor_ops(*g_audio_preprocessor_op_resolver)
	    != kTfLiteOk) {
		LOG_ERR("Failed to register audio preprocessor ops");
		return kTfLiteError;
	}

	static tflite::MicroInterpreter audio_preprocessor_interpreter(
		g_audio_preprocessor_model,
		*g_audio_preprocessor_op_resolver,
		g_audio_preprocessor_arena,
		kAudioPreprocessorArenaSize);
	g_audio_preprocessor_interpreter = &audio_preprocessor_interpreter;
	if (g_audio_preprocessor_interpreter->AllocateTensors() != kTfLiteOk) {
		LOG_ERR("Audio preprocessor tensor allocation failed");
		return kTfLiteError;
	}

	/* Micro speech classifier */
	g_micro_speech_model =
		tflite::GetModel(g_micro_speech_quantized_model);
	if (g_micro_speech_model->version() != TFLITE_SCHEMA_VERSION) {
		LOG_ERR("Micro speech model schema mismatch");
		return kTfLiteError;
	}

	static MicroSpeechOpResolver micro_speech_op_resolver;
	g_micro_speech_op_resolver = &micro_speech_op_resolver;
	if (register_micro_speech_ops(*g_micro_speech_op_resolver) != kTfLiteOk) {
		LOG_ERR("Failed to register micro speech ops");
		return kTfLiteError;
	}

	static tflite::MicroInterpreter micro_speech_interpreter(
		g_micro_speech_model,
		*g_micro_speech_op_resolver,
		g_micro_speech_arena,
		kMicroSpeechArenaSize);
	g_micro_speech_interpreter = &micro_speech_interpreter;
	if (g_micro_speech_interpreter->AllocateTensors() != kTfLiteOk) {
		LOG_ERR("Micro speech tensor allocation failed");
		return kTfLiteError;
	}

	g_initialized = true;
	LOG_INF("TFLM interpreters initialized");
	return kTfLiteOk;
}

/* -----------------------------------------------------------------------
 * Feature generation
 * ----------------------------------------------------------------------- */
static TfLiteStatus generate_single_feature(const int16_t *audio_data,
					    int audio_data_size,
					    int8_t *feature_output)
{
	TfLiteTensor *input =
		g_audio_preprocessor_interpreter->input(0);
	if (!input) {
		return kTfLiteError;
	}
	if (audio_data_size != kAudioSampleDurationCount) {
		LOG_ERR("Feature window size mismatch: %d vs %d",
			audio_data_size, kAudioSampleDurationCount);
		return kTfLiteError;
	}

	TfLiteTensor *output =
		g_audio_preprocessor_interpreter->output(0);
	if (!output) {
		return kTfLiteError;
	}

	std::copy_n(audio_data, audio_data_size,
		    tflite::GetTensorData<int16_t>(input));

	if (g_audio_preprocessor_interpreter->Invoke() != kTfLiteOk) {
		LOG_ERR("Audio preprocessor invoke failed");
		return kTfLiteError;
	}

#if defined(MICRO_SPEECH_FLOAT_PREPROCESSOR)
	/*
	 * Float preprocessor emits float32 features.  Quantize them to int8
	 * using the classifier input tensor's own scale/zero_point so the
	 * values land in the range the INT8 classifier was trained on.
	 */
	{
		const float *f = tflite::GetTensorData<float>(output);
		TfLiteTensor *cls_in = g_micro_speech_interpreter->input(0);
		const float scale      = cls_in->params.scale;
		const int   zero_point = cls_in->params.zero_point;

		for (int i = 0; i < kFeatureSize; i++) {
			int32_t q = static_cast<int32_t>(roundf(f[i] / scale))
				    + zero_point;
			q = std::max(-128, std::min(127, q));
			feature_output[i] = static_cast<int8_t>(q);
		}
	}
#else
	std::copy_n(tflite::GetTensorData<int8_t>(output),
		    kFeatureSize, feature_output);
#endif
	return kTfLiteOk;
}

static TfLiteStatus generate_features(const int16_t *audio_data,
				      size_t audio_data_size,
				      Features *features_output)
{
	memset(features_output, 0, sizeof(Features));

	size_t remaining    = audio_data_size;
	size_t feature_idx  = 0;
	const int16_t *ptr  = audio_data;

	while (remaining >= (size_t)kAudioSampleDurationCount &&
	       feature_idx < kFeatureCount) {
		if (generate_single_feature(ptr, kAudioSampleDurationCount,
					    (*features_output)[feature_idx])
		    != kTfLiteOk) {
			LOG_ERR("Feature %zu generation failed", feature_idx);
			return kTfLiteError;
		}
		feature_idx++;
		ptr       += kAudioSampleStrideCount;
		remaining -= kAudioSampleStrideCount;
	}

	return kTfLiteOk;
}

/* -----------------------------------------------------------------------
 * Inference
 * ----------------------------------------------------------------------- */
static TfLiteStatus run_inference(const Features &features)
{
	TfLiteTensor *input = g_micro_speech_interpreter->input(0);
	TfLiteTensor *output = g_micro_speech_interpreter->output(0);

	if (!input || !output) {
		return kTfLiteError;
	}
	if (output->dims->data[output->dims->size - 1] != kCategoryCount) {
		LOG_ERR("Output tensor size mismatch");
		return kTfLiteError;
	}

	std::copy_n(&features[0][0], kFeatureElementCount,
		    tflite::GetTensorData<int8_t>(input));

	if (g_micro_speech_interpreter->Invoke() != kTfLiteOk) {
		LOG_ERR("Micro speech invoke failed");
		return kTfLiteError;
	}

	float output_scale      = output->params.scale;
	int   output_zero_point = output->params.zero_point;

	float scores[kCategoryCount];
	const int8_t *raw = tflite::GetTensorData<int8_t>(output);

	for (int i = 0; i < kCategoryCount; i++) {
		scores[i] = (raw[i] - output_zero_point) * output_scale;
	}

	int best = (int)(std::max_element(scores, scores + kCategoryCount) -
			 scores);
	LOG_INF("Detected: %s", kCategoryLabels[best]);

	return kTfLiteOk;
}

} /* namespace */

/* -----------------------------------------------------------------------
 * Public C API
 * ----------------------------------------------------------------------- */
extern "C" {

void model_runner_init(void)
{
	if (initialize_interpreters() != kTfLiteOk) {
		LOG_ERR("Failed to initialize TFLM interpreters");
	}
}

int micro_speech_process_audio(const int16_t *audio_data,
			       size_t audio_data_size)
{
	if (generate_features(audio_data, audio_data_size,
			      &g_features) != kTfLiteOk) {
		LOG_ERR("Feature generation failed");
		return -1;
	}
	if (run_inference(g_features) != kTfLiteOk) {
		LOG_ERR("Inference failed");
		return -2;
	}
	return 0;
}

} /* extern "C" */
```
