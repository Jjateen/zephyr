## CMakeLists.txt
```
cmake_minimum_required(VERSION 3.20.0)

find_package(Zephyr REQUIRED HINTS $ENV{ZEPHYR_BASE})
project(micro_speech_xiao_v4)

set(NO_THREADSAFE_STATICS $<TARGET_PROPERTY:compiler-cpp,no_threadsafe_statics>)
zephyr_compile_options($<$<COMPILE_LANGUAGE:CXX>:${NO_THREADSAFE_STATICS}>)

set(OPTIONAL_TFLITE_DIR $ENV{ZEPHYR_BASE}/../optional/modules/lib/tflite-micro/signal)

if(MICRO_SPEECH_FLOAT_PREPROCESSOR)
  message(STATUS "micro_speech_xiao_v4: preprocessor = float32")
  zephyr_compile_definitions(MICRO_SPEECH_FLOAT_PREPROCESSOR=1)
else()
  message(STATUS "micro_speech_xiao_v4: preprocessor = INT8 quantized (default)")
endif()

file(GLOB app_sources src/*.cpp src/*.c)

target_include_directories(
  app
  PRIVATE
  src
  ${ZEPHYR_TFLITE_MICRO_MODULE_DIR}/signal
  ${ZEPHYR_TFLITE_MICRO_MODULE_DIR}/signal/micro/kernels/
  ${ZEPHYR_TFLITE_MICRO_MODULE_DIR}/signal/src
)

target_sources(
  app
  PRIVATE
  ${app_sources}

  # Signal processing
  ${OPTIONAL_TFLITE_DIR}/src/fft_auto_scale.cc
  ${OPTIONAL_TFLITE_DIR}/src/max_abs.cc
  ${OPTIONAL_TFLITE_DIR}/src/msb_32.cc
  ${OPTIONAL_TFLITE_DIR}/src/energy.cc
  ${OPTIONAL_TFLITE_DIR}/src/filter_bank.cc
  ${OPTIONAL_TFLITE_DIR}/src/filter_bank_square_root.cc
  ${OPTIONAL_TFLITE_DIR}/src/square_root_64.cc
  ${OPTIONAL_TFLITE_DIR}/src/square_root_32.cc
  ${OPTIONAL_TFLITE_DIR}/src/msb_64.cc
  ${OPTIONAL_TFLITE_DIR}/src/pcan_argc_fixed.cc
  ${OPTIONAL_TFLITE_DIR}/src/filter_bank_log.cc
  ${OPTIONAL_TFLITE_DIR}/src/log.cc
  ${OPTIONAL_TFLITE_DIR}/src/filter_bank_spectral_subtraction.cc

  # Micro kernels
  ${OPTIONAL_TFLITE_DIR}/micro/kernels/energy.cc
  ${OPTIONAL_TFLITE_DIR}/micro/kernels/fft_auto_scale_common.cc
  ${OPTIONAL_TFLITE_DIR}/micro/kernels/fft_auto_scale_kernel.cc
  ${OPTIONAL_TFLITE_DIR}/micro/kernels/filter_bank_square_root_common.cc
  ${OPTIONAL_TFLITE_DIR}/micro/kernels/filter_bank_square_root.cc
  ${OPTIONAL_TFLITE_DIR}/micro/kernels/filter_bank_spectral_subtraction.cc
  ${OPTIONAL_TFLITE_DIR}/micro/kernels/filter_bank.cc
  ${OPTIONAL_TFLITE_DIR}/micro/kernels/pcan.cc
  ${OPTIONAL_TFLITE_DIR}/micro/kernels/filter_bank_log.cc
)
```

## sample.yaml
```
sample:
  description: Micro Speech v4 — 10-class keyword spotter (tiny_conv_v4) for Seeed XIAO BLE Sense (nRF52840)
  name: micro speech xiao v4
common:
  tags:
    - tensorflow
    - audio
    - ml
  build_only: true
  modules:
    - tflite-micro
  harness: console
  harness_config:
    type: multi_line
    ordered: false
    regex:
      - "Detected: (silence|unknown|down|go|left|off|on|right|stop|up)"
tests:
  sample.tensorflow.micro_speech_xiao_v4:
    integration_platforms:
      - xiao_ble/nrf52840/sense
    platform_allow:
      - xiao_ble/nrf52840/sense
```

## prj.conf
```kconfig
# Enable hardware FPU (Cortex-M4F) — avoids ~50x penalty from soft-float emulation
CONFIG_FPU=y
CONFIG_FPU_SHARING=y

# Use ARM CMSIS-NN optimized kernels instead of reference C implementations
# Replaces Conv2D/FC/Pooling with SIMD-accelerated versions → ~10-100x faster inference
CONFIG_TENSORFLOW_LITE_MICRO_CMSIS_NN_KERNELS=y

# TFLite Micro
CONFIG_CPP=y
CONFIG_STD_CPP17=y
CONFIG_TENSORFLOW_LITE_MICRO=y
# stack size needed to safely initialize
# and run TensorFlow Lite Micro operations
# in the main thread
CONFIG_MAIN_STACK_SIZE=6144
CONFIG_REQUIRES_FLOAT_PRINTF=y

# PDM microphone via Zephyr audio/dmic API
CONFIG_AUDIO=y
CONFIG_AUDIO_DMIC=y

# USB CDC ACM for serial output (same as hello_world setup)
CONFIG_USB_DEVICE_STACK_NEXT=y
CONFIG_USBD_CDC_ACM_CLASS=y
CONFIG_UART_LINE_CTRL=y

# Logging
CONFIG_LOG=y
CONFIG_LOG_DEFAULT_LEVEL=3
CONFIG_PRINTK=y
```

## usb_serial.conf
```kconfig
CONFIG_USB_DEVICE_STACK_NEXT=y
CONFIG_USBD_CDC_ACM_CLASS=y
CONFIG_CDC_ACM_SERIAL_INITIALIZE_AT_BOOT=y
CONFIG_UART_LINE_CTRL=y
CONFIG_LOG=y
CONFIG_PRINTK=y
```

## src/main.cpp
```c
/*
 * Copyright 2025 The TensorFlow Authors. All Rights Reserved.
 *
 * Licensed under the Apache License, Version 2.0 (the "License");
 * you may not use this file except in compliance with the License.
 * You may obtain a copy of the License at
 *
 *     http://www.apache.org/licenses/LICENSE-2.0
 *
 * Unless required by applicable law or agreed to in writing, software
 * distributed under the License is distributed on an "AS IS" BASIS,
 * WITHOUT WARRANTIES OR CONDITIONS OF ANY KIND, either express or implied.
 * See the License for the specific language governing permissions and
 * limitations under the License.
 *
 * SPDX-License-Identifier: Apache-2.0
 */

#include "main_functions.hpp"

#include <zephyr/kernel.h>
#include <zephyr/drivers/uart.h>
#include <zephyr/devicetree.h>

int main(int argc, char *argv[])
{
#if defined(CONFIG_UART_LINE_CTRL)
	/* Wait for the USB CDC-ACM host to open the port (DTR asserted)
	 * before starting so that early log messages are not lost. */
	const struct device *console =
		DEVICE_DT_GET(DT_CHOSEN(zephyr_console));
	if (device_is_ready(console)) {
		uint32_t dtr = 0;
		while (!dtr) {
			uart_line_ctrl_get(console,
					   UART_LINE_CTRL_DTR, &dtr);
			k_sleep(K_MSEC(100));
		}
	}
#endif

	setup();
	while (1) {
		loop();
	}
	return 0;
}
```

## src/audio_provider.cpp
```c
/*
 * Copyright 2025 The TensorFlow Authors. All Rights Reserved.
 *
 * Licensed under the Apache License, Version 2.0 (the "License");
 * you may not use this file except in compliance with the License.
 * You may obtain a copy of the License at
 *
 *     http://www.apache.org/licenses/LICENSE-2.0
 *
 * Unless required by applicable law or agreed to in writing, software
 * distributed under the License is distributed on an "AS IS" BASIS,
 * WITHOUT WARRANTIES OR CONDITIONS OF ANY KIND, either express or implied.
 * See the License for the specific language governing permissions and
 * limitations under the License.
 *
 * SPDX-License-Identifier: Apache-2.0
 */

#include "audio_provider.h"

#include <zephyr/kernel.h>
#include <zephyr/device.h>
#include <zephyr/drivers/gpio.h>
#include <zephyr/audio/dmic.h>
#include <zephyr/logging/log.h>

LOG_MODULE_REGISTER(audio_provider);

/* -----------------------------------------------------------------------
 * Hardware constants for the XIAO BLE Sense
 * PDM mic power enable: GPIO1 pin 10, active-high
 * (MSM261D3526HICPM-C regulator in the board DTS has no label so we
 *  drive the GPIO directly from code.)
 * ----------------------------------------------------------------------- */
#define MIC_PWR_PORT  DT_NODELABEL(gpio1)
#define MIC_PWR_PIN   10

/* -----------------------------------------------------------------------
 * DMIC / PDM configuration
 * 16 kHz, 16-bit, mono – matching the TFLM model requirements.
 * Block size: 30 ms = 480 samples = 960 bytes.
 * We keep 4 blocks in the slab so the driver never stalls.
 * ----------------------------------------------------------------------- */
#define SAMPLE_RATE_HZ   16000
#define SAMPLE_BIT_WIDTH 16
#define NUM_CHANNELS     1
#define BLOCK_MS         30
#define BLOCK_SAMPLES    (SAMPLE_RATE_HZ * BLOCK_MS / 1000)   /* 480 */
#define BLOCK_BYTES      (BLOCK_SAMPLES * sizeof(int16_t))     /* 960 */
#define SLAB_BLOCK_COUNT 8

K_MEM_SLAB_DEFINE_STATIC(audio_slab, BLOCK_BYTES, SLAB_BLOCK_COUNT, 4);

static const struct device *dmic_dev;
static bool g_initialized;

int audio_provider_init(void)
{
	if (g_initialized) {
		return 0;
	}

	/* Power on the PDM microphone */
	const struct device *mic_pwr = DEVICE_DT_GET(MIC_PWR_PORT);

	if (!device_is_ready(mic_pwr)) {
		LOG_ERR("GPIO1 not ready");
		return -ENODEV;
	}
	gpio_pin_configure(mic_pwr, MIC_PWR_PIN, GPIO_OUTPUT_ACTIVE);
	/* Datasheet requires ≥ 1 ms after power-on before the first clock */
	k_msleep(5);

	/* Get the dmic device – aliased as "dmic_dev" in the overlay */
	dmic_dev = DEVICE_DT_GET(DT_NODELABEL(dmic_dev));
	if (!device_is_ready(dmic_dev)) {
		LOG_ERR("DMIC device not ready");
		return -ENODEV;
	}

	struct pcm_stream_cfg stream = {
		.pcm_width = SAMPLE_BIT_WIDTH,
		.mem_slab  = &audio_slab,
	};

	struct dmic_cfg cfg = {
		.io = {
			.min_pdm_clk_freq = 1000000,
			.max_pdm_clk_freq = 3500000,
			.min_pdm_clk_dc   = 40,
			.max_pdm_clk_dc   = 60,
		},
		.streams          = &stream,
		.channel = {
			.req_num_chan    = NUM_CHANNELS,
			.req_num_streams = 1,
		},
	};

	cfg.channel.req_chan_map_lo =
		dmic_build_channel_map(0, 0, PDM_CHAN_LEFT);
	cfg.streams[0].pcm_rate  = SAMPLE_RATE_HZ;
	cfg.streams[0].block_size = BLOCK_BYTES;

	int ret = dmic_configure(dmic_dev, &cfg);

	if (ret < 0) {
		LOG_ERR("dmic_configure failed: %d", ret);
		return ret;
	}

	ret = dmic_trigger(dmic_dev, DMIC_TRIGGER_START);
	if (ret < 0) {
		LOG_ERR("DMIC START trigger failed: %d", ret);
		return ret;
	}

	g_initialized = true;
	LOG_INF("Audio provider initialized (%d Hz, %d-bit, %d ch)",
		SAMPLE_RATE_HZ, SAMPLE_BIT_WIDTH, NUM_CHANNELS);
	return 0;
}

int audio_provider_read(int16_t *buffer, size_t num_samples,
			uint32_t timeout_ms)
{
	if (!g_initialized) {
		return -EAGAIN;
	}

	size_t samples_collected = 0;

	while (samples_collected < num_samples) {
		void *block;
		uint32_t block_size;

		int ret = dmic_read(dmic_dev, 0, &block, &block_size,
				    timeout_ms);
		if (ret < 0) {
			LOG_ERR("dmic_read failed: %d", ret);
			return ret;
		}

		size_t block_samples = block_size / sizeof(int16_t);
		size_t remaining     = num_samples - samples_collected;
		size_t to_copy       = (block_samples < remaining)
					? block_samples : remaining;

		memcpy(buffer + samples_collected, block,
		       to_copy * sizeof(int16_t));
		samples_collected += to_copy;

		k_mem_slab_free(&audio_slab, block);
	}

	return 0;
}
```

## src/audio_provider.h
```c
/*
 * Copyright 2025 The TensorFlow Authors. All Rights Reserved.
 *
 * Licensed under the Apache License, Version 2.0 (the "License");
 * you may not use this file except in compliance with the License.
 * You may obtain a copy of the License at
 *
 *     http://www.apache.org/licenses/LICENSE-2.0
 *
 * Unless required by applicable law or agreed to in writing, software
 * distributed under the License is distributed on an "AS IS" BASIS,
 * WITHOUT WARRANTIES OR CONDITIONS OF ANY KIND, either express or implied.
 * See the License for the specific language governing permissions and
 * limitations under the License.
 *
 * SPDX-License-Identifier: Apache-2.0
 */

#ifndef MICRO_SPEECH_XIAO_AUDIO_PROVIDER_H_
#define MICRO_SPEECH_XIAO_AUDIO_PROVIDER_H_

#include <stddef.h>
#include <stdint.h>

#ifdef __cplusplus
extern "C" {
#endif

/**
 * @brief Power on the PDM mic, configure and start the DMIC driver.
 *
 * Must be called once before audio_provider_read().
 *
 * @return 0 on success, negative errno on failure.
 */
int audio_provider_init(void);

/**
 * @brief Read exactly @p num_samples mono int16 samples from the PDM mic.
 *
 * Blocks until enough samples have been collected or @p timeout_ms expires.
 *
 * @param buffer      Destination buffer (must hold at least num_samples int16).
 * @param num_samples Number of samples to read.
 * @param timeout_ms  Maximum time to wait (milliseconds).
 *
 * @return 0 on success, negative errno on failure or timeout.
 */
int audio_provider_read(int16_t *buffer, size_t num_samples,
			uint32_t timeout_ms);

#ifdef __cplusplus
}
#endif

#endif /* MICRO_SPEECH_XIAO_AUDIO_PROVIDER_H_ */
```

## src/main_functions.cpp
```c
/*
 * Copyright 2025 The TensorFlow Authors. All Rights Reserved.
 *
 * Licensed under the Apache License, Version 2.0 (the "License");
 * you may not use this file except in compliance with the License.
 * You may obtain a copy of the License at
 *
 *     http://www.apache.org/licenses/LICENSE-2.0
 *
 * Unless required by applicable law or agreed to in writing, software
 * distributed under the License is distributed on an "AS IS" BASIS,
 * WITHOUT WARRANTIES OR CONDITIONS OF ANY KIND, either express or implied.
 * See the License for the specific language governing permissions and
 * limitations under the License.
 *
 * SPDX-License-Identifier: Apache-2.0
 */

#include "main_functions.hpp"

#include <zephyr/logging/log.h>
LOG_MODULE_REGISTER(micro_speech_xiao);

#include "audio_provider.h"
#include "model_runner.h"
#include "micro_model_settings.h"

#include <zephyr/kernel.h>
#include <string.h>

/* Audio constants */
#define SAMPLES_PER_SECOND      (16000)
/* Trigger every 500 ms — slides the 1-second inference window forward */
#define TRIGGER_SAMPLES         (SAMPLES_PER_SECOND / 2)   /* 8000 */
#define TRIGGER_BYTES           (TRIGGER_SAMPLES * sizeof(int16_t))
/* Inference always operates on a full 1-second window */
#define INFERENCE_SAMPLES       (SAMPLES_PER_SECOND)
#define INFERENCE_BYTES         (INFERENCE_SAMPLES * sizeof(int16_t))

/* Thread stack sizes */
#define CAPTURE_STACK_SIZE      (2048)
#define INFERENCE_STACK_SIZE    (4096)

/*
 * Sliding-window buffers:
 *   capture_a / capture_b  – double-buffered 500 ms chunks
 *   inference_buf_a / b    – double-buffered 1-second windows passed to TFLM
 *
 * Layout of each inference buffer (updated every 500 ms):
 *   [  old 500 ms  |  new 500 ms  ]
 *        ↑ shifted left each trigger
 */
static int16_t capture_a[TRIGGER_SAMPLES];
static int16_t capture_b[TRIGGER_SAMPLES];
static int16_t *write_buffer   = capture_a;
static int16_t *new_chunk      = capture_b;   /* alias: filled chunk ready to slide in */

static int16_t infer_a[INFERENCE_SAMPLES];
static int16_t infer_b[INFERENCE_SAMPLES];
static int16_t *inference_buf  = infer_a;     /* being read by inference thread */
static int16_t *staging_buf    = infer_b;     /* being built by capture thread  */

static size_t g_samples_in_write_buffer;

K_THREAD_STACK_DEFINE(capture_stack, CAPTURE_STACK_SIZE);
K_THREAD_STACK_DEFINE(inference_stack, INFERENCE_STACK_SIZE);
static struct k_thread capture_thread_data;
static struct k_thread inference_thread_data;

static K_SEM_DEFINE(buffer_ready_sem, 0, 1);
static K_SEM_DEFINE(inference_done_sem, 1, 1);
static K_MUTEX_DEFINE(buffer_mutex);

/*
 * PDM capture thread — sliding-window approach.
 *
 * Accumulates 500 ms (TRIGGER_SAMPLES) of audio into write_buffer.
 * When full, it slides the 1-second staging_buf forward:
 *   staging_buf = [ old second half | new 500 ms chunk ]
 * then hands staging_buf off to the inference thread.
 *
 * Because the capture window is only 500 ms, even if one trigger is
 * dropped (inference busy), the next trigger fires 500 ms later —
 * keeping worst-case latency under ~2 seconds.
 */
extern "C" void audio_capture_thread(void *arg1, void *arg2, void *arg3)
{
	ARG_UNUSED(arg1);
	ARG_UNUSED(arg2);
	ARG_UNUSED(arg3);

	const size_t block_samples =
		(size_t)(kFeatureDurationMs * kAudioSampleFrequency / 1000);
	static int16_t block_buf[kFeatureDurationMs * kAudioSampleFrequency / 1000];

	LOG_INF("Audio capture thread started");

	while (1) {
		int ret = audio_provider_read(block_buf, block_samples, 200);

		if (ret < 0) {
			LOG_ERR("PDM read error: %d", ret);
			continue;
		}

		k_mutex_lock(&buffer_mutex, K_FOREVER);

		size_t space    = TRIGGER_SAMPLES - g_samples_in_write_buffer;
		size_t to_copy  = (block_samples < space) ? block_samples : space;

		memcpy(write_buffer + g_samples_in_write_buffer,
		       block_buf, to_copy * sizeof(int16_t));
		g_samples_in_write_buffer += to_copy;

		if (g_samples_in_write_buffer >= TRIGGER_SAMPLES) {
			/*
			 * Slide the staging buffer:
			 *   [ discard first 500ms | keep second 500ms ]
			 * then append the freshly captured 500ms chunk.
			 */
			memmove(staging_buf,
				staging_buf + TRIGGER_SAMPLES,
				TRIGGER_BYTES);
			memcpy(staging_buf + TRIGGER_SAMPLES,
			       write_buffer, TRIGGER_BYTES);

			/* Swap capture buffers regardless */
			int16_t *tmp  = write_buffer;
			write_buffer  = new_chunk;
			new_chunk     = tmp;
			g_samples_in_write_buffer = 0;

			if (k_sem_take(&inference_done_sem, K_NO_WAIT) == 0) {
				/* Hand staging_buf to inference */
				int16_t *itmp  = inference_buf;
				inference_buf  = staging_buf;
				staging_buf    = itmp;
				k_sem_give(&buffer_ready_sem);
			}
			/* If inference is busy: drop this trigger, keep
			 * updating staging_buf so it stays fresh. */
		}

		k_mutex_unlock(&buffer_mutex);
	}
}

/*
 * Inference thread.
 *
 * Waits for a full second of audio, runs the TFLM pipeline and logs the
 * detected keyword.
 */
extern "C" void audio_inference_thread(void *arg1, void *arg2, void *arg3)
{
	ARG_UNUSED(arg1);
	ARG_UNUSED(arg2);
	ARG_UNUSED(arg3);

	LOG_INF("Inference thread started");

	while (1) {
		k_sem_take(&buffer_ready_sem, K_FOREVER);

		if (micro_speech_process_audio(inference_buf,
					       INFERENCE_SAMPLES) != 0) {
			LOG_ERR("Inference failed");
		}

		/* Buffer is handed back to staging — no memset needed */
		k_sem_give(&inference_done_sem);
	}
}

extern "C" {

void setup(void)
{
	LOG_INF("Starting Micro Speech XIAO application");

	/* Power on the PDM microphone (MSM261D3526HICPM-C, enable pin P1.10) */
	if (audio_provider_init() != 0) {
		LOG_ERR("Failed to init audio provider");
		return;
	}

	/* Initialize TFLM interpreters */
	model_runner_init();

	/* Capture thread – higher priority */
	k_thread_create(&capture_thread_data, capture_stack,
			CAPTURE_STACK_SIZE,
			audio_capture_thread, NULL, NULL, NULL,
			5, 0, K_NO_WAIT);
	k_thread_name_set(&capture_thread_data, "pdm_capture");

	/* Inference thread – lower priority */
	k_thread_create(&inference_thread_data, inference_stack,
			INFERENCE_STACK_SIZE,
			audio_inference_thread, NULL, NULL, NULL,
			6, 0, K_NO_WAIT);
	k_thread_name_set(&inference_thread_data, "ml_inference");
}

void loop(void)
{
	k_sleep(K_FOREVER);
}

} /* extern "C" */
```

## src/main_functions.hpp
```c
/*
 * Copyright 2025 The TensorFlow Authors. All Rights Reserved.
 *
 * Licensed under the Apache License, Version 2.0 (the "License");
 * you may not use this file except in compliance with the License.
 * You may obtain a copy of the License at
 *
 *     http://www.apache.org/licenses/LICENSE-2.0
 *
 * Unless required by applicable law or agreed to in writing, software
 * distributed under the License is distributed on an "AS IS" BASIS,
 * WITHOUT WARRANTIES OR CONDITIONS OF ANY KIND, either express or implied.
 * See the License for the specific language governing permissions and
 * limitations under the License.
 *
 * SPDX-License-Identifier: Apache-2.0
 */

#ifndef MICRO_SPEECH_XIAO_MAIN_FUNCTIONS_H_
#define MICRO_SPEECH_XIAO_MAIN_FUNCTIONS_H_

extern "C" {
void setup(void);
void loop(void);
}

#endif /* MICRO_SPEECH_XIAO_MAIN_FUNCTIONS_H_ */
```

## src/micro_model_settings.h
```c
/*
 * SPDX-License-Identifier: Apache-2.0
 *
 * Model settings for the tiny_conv_v4 10-class keyword spotter.
 * Trained on Google Speech Commands v2 with PREPROCESS=micro,
 * WINDOW_SIZE_MS=30, WINDOW_STRIDE=20, FEATURE_BIN_COUNT=40.
 */

#ifndef MICRO_SPEECH_XIAO_V4_MODEL_SETTINGS_H_
#define MICRO_SPEECH_XIAO_V4_MODEL_SETTINGS_H_

constexpr int kAudioSampleFrequency = 16000;
constexpr int kFeatureSize          = 40;
constexpr int kFeatureCount         = 49;
constexpr int kFeatureElementCount  = (kFeatureSize * kFeatureCount);
constexpr int kFeatureStrideMs      = 20;
constexpr int kFeatureDurationMs    = 30;

/* 10-class output: silence + unknown + 8 wanted words in training order.
 * WANTED_WORDS = "up,down,go,stop,left,right,on,off"
 * prepare_words_list() prepends silence/unknown without sorting. */
constexpr int kCategoryCount = 10;
constexpr const char *kCategoryLabels[kCategoryCount] = {
	"silence",  /* 0 */
	"unknown",  /* 1 */
	"up",       /* 2 */
	"down",     /* 3 */
	"go",       /* 4 */
	"stop",     /* 5 */
	"left",     /* 6 */
	"right",    /* 7 */
	"on",       /* 8 */
	"off",      /* 9 */
};

#endif /* MICRO_SPEECH_XIAO_V4_MODEL_SETTINGS_H_ */
```

## src/model_runner.cpp
```c
/*
 * SPDX-License-Identifier: Apache-2.0
 *
 * model_runner.cpp — tiny_conv_v4 classifier + MFSC audio preprocessor.
 *
 * Two-model pipeline:
 *   1. Audio preprocessor (INT8 or float32): 480-sample PCM → 40-bin MFSC
 *   2. tiny_conv_v4 classifier (INT8):       49×40 features → 10-class logits
 *
 * Op set for tiny_conv_v4 (standard conv, BN folded at quantization):
 *   Conv2D × 3, MaxPool2D × 2, Reshape, FullyConnected, Softmax
 */

#include "model_runner.h"

#include <zephyr/logging/log.h>
LOG_MODULE_REGISTER(model_runner);

#include "tensorflow/lite/core/c/common.h"
#include "tensorflow/lite/micro/micro_interpreter.h"
#include "tensorflow/lite/micro/micro_log.h"
#include "tensorflow/lite/micro/micro_mutable_op_resolver.h"

#if defined(MICRO_SPEECH_FLOAT_PREPROCESSOR)
#include "audio_preprocessor_float_model.hpp"
#define g_audio_preprocessor_model_data g_audio_preprocessor_float_model
#else
#include "audio_preprocessor_int8_model.hpp"
#define g_audio_preprocessor_model_data g_audio_preprocessor_int8_model
#endif

#include "tiny_conv_v4_model.hpp"
#include "micro_model_settings.h"

#include <zephyr/kernel.h>
#include <algorithm>
#include <string.h>
#include <math.h>

/* -----------------------------------------------------------------------
 * Op resolvers
 * ----------------------------------------------------------------------- */
/* tiny_conv_v4 uses standard Conv2D (not depthwise) + MaxPool2D */
using MicroSpeechOpResolver      = tflite::MicroMutableOpResolver<5>;
using AudioPreprocessorOpResolver = tflite::MicroMutableOpResolver<18>;

using Features = int8_t[kFeatureCount][kFeatureSize];

/* -----------------------------------------------------------------------
 * Tensor arenas
 * ----------------------------------------------------------------------- */
namespace {

#if defined(MICRO_SPEECH_FLOAT_PREPROCESSOR)
constexpr size_t kAudioPreprocessorArenaSize = 32768;
#else
constexpr size_t kAudioPreprocessorArenaSize = 16384;
#endif

/* tiny_conv_v4 peak activation: Conv2 output [1,25,20,48] = 24 000 B.
 * Allocator reported needing 34240 B; use 40 KB for headroom. */
constexpr size_t kMicroSpeechArenaSize = 40960;

alignas(16) uint8_t g_audio_preprocessor_arena[kAudioPreprocessorArenaSize];
alignas(16) uint8_t g_micro_speech_arena[kMicroSpeechArenaSize];

constexpr int kAudioSampleDurationCount =
	kFeatureDurationMs * kAudioSampleFrequency / 1000;
constexpr int kAudioSampleStrideCount =
	kFeatureStrideMs * kAudioSampleFrequency / 1000;

static const tflite::Model *g_audio_preprocessor_model;
static const tflite::Model *g_micro_speech_model;
static AudioPreprocessorOpResolver *g_audio_preprocessor_op_resolver;
static MicroSpeechOpResolver       *g_micro_speech_op_resolver;
static tflite::MicroInterpreter    *g_audio_preprocessor_interpreter;
static tflite::MicroInterpreter    *g_micro_speech_interpreter;
static bool g_initialized;

static Features g_features;

/* -----------------------------------------------------------------------
 * Op registration
 * ----------------------------------------------------------------------- */
static TfLiteStatus register_micro_speech_ops(MicroSpeechOpResolver &r)
{
	TF_LITE_ENSURE_STATUS(r.AddReshape());
	TF_LITE_ENSURE_STATUS(r.AddConv2D());
	TF_LITE_ENSURE_STATUS(r.AddMaxPool2D());
	TF_LITE_ENSURE_STATUS(r.AddFullyConnected());
	TF_LITE_ENSURE_STATUS(r.AddSoftmax());
	return kTfLiteOk;
}

static TfLiteStatus register_audio_preprocessor_ops(AudioPreprocessorOpResolver &r)
{
	TF_LITE_ENSURE_STATUS(r.AddReshape());
	TF_LITE_ENSURE_STATUS(r.AddCast());
	TF_LITE_ENSURE_STATUS(r.AddStridedSlice());
	TF_LITE_ENSURE_STATUS(r.AddConcatenation());
	TF_LITE_ENSURE_STATUS(r.AddMul());
	TF_LITE_ENSURE_STATUS(r.AddAdd());
	TF_LITE_ENSURE_STATUS(r.AddDiv());
	TF_LITE_ENSURE_STATUS(r.AddMinimum());
	TF_LITE_ENSURE_STATUS(r.AddMaximum());
	TF_LITE_ENSURE_STATUS(r.AddWindow());
	TF_LITE_ENSURE_STATUS(r.AddFftAutoScale());
	TF_LITE_ENSURE_STATUS(r.AddRfft());
	TF_LITE_ENSURE_STATUS(r.AddEnergy());
	TF_LITE_ENSURE_STATUS(r.AddFilterBank());
	TF_LITE_ENSURE_STATUS(r.AddFilterBankSquareRoot());
	TF_LITE_ENSURE_STATUS(r.AddFilterBankSpectralSubtraction());
	TF_LITE_ENSURE_STATUS(r.AddPCAN());
	TF_LITE_ENSURE_STATUS(r.AddFilterBankLog());
	return kTfLiteOk;
}

/* -----------------------------------------------------------------------
 * Interpreter initialisation
 * ----------------------------------------------------------------------- */
static TfLiteStatus initialize_interpreters(void)
{
	if (g_initialized) {
		return kTfLiteOk;
	}

#if defined(MICRO_SPEECH_FLOAT_PREPROCESSOR)
	LOG_INF("Initializing TFLM [tiny_conv_v4, preprocessor: float32]");
#else
	LOG_INF("Initializing TFLM [tiny_conv_v4, preprocessor: INT8]");
#endif

	g_audio_preprocessor_model =
		tflite::GetModel(g_audio_preprocessor_model_data);
	if (g_audio_preprocessor_model->version() != TFLITE_SCHEMA_VERSION) {
		LOG_ERR("Audio preprocessor model schema mismatch");
		return kTfLiteError;
	}

	static AudioPreprocessorOpResolver audio_preprocessor_op_resolver;
	g_audio_preprocessor_op_resolver = &audio_preprocessor_op_resolver;
	if (register_audio_preprocessor_ops(*g_audio_preprocessor_op_resolver)
	    != kTfLiteOk) {
		LOG_ERR("Failed to register audio preprocessor ops");
		return kTfLiteError;
	}

	static tflite::MicroInterpreter audio_preprocessor_interpreter(
		g_audio_preprocessor_model,
		*g_audio_preprocessor_op_resolver,
		g_audio_preprocessor_arena,
		kAudioPreprocessorArenaSize);
	g_audio_preprocessor_interpreter = &audio_preprocessor_interpreter;
	if (g_audio_preprocessor_interpreter->AllocateTensors() != kTfLiteOk) {
		LOG_ERR("Audio preprocessor tensor allocation failed");
		return kTfLiteError;
	}

	g_micro_speech_model = tflite::GetModel(g_tiny_conv_v4_model);
	if (g_micro_speech_model->version() != TFLITE_SCHEMA_VERSION) {
		LOG_ERR("tiny_conv_v4 model schema mismatch");
		return kTfLiteError;
	}

	static MicroSpeechOpResolver micro_speech_op_resolver;
	g_micro_speech_op_resolver = &micro_speech_op_resolver;
	if (register_micro_speech_ops(*g_micro_speech_op_resolver) != kTfLiteOk) {
		LOG_ERR("Failed to register micro speech ops");
		return kTfLiteError;
	}

	static tflite::MicroInterpreter micro_speech_interpreter(
		g_micro_speech_model,
		*g_micro_speech_op_resolver,
		g_micro_speech_arena,
		kMicroSpeechArenaSize);
	g_micro_speech_interpreter = &micro_speech_interpreter;
	if (g_micro_speech_interpreter->AllocateTensors() != kTfLiteOk) {
		LOG_ERR("tiny_conv_v4 tensor allocation failed — try increasing kMicroSpeechArenaSize");
		return kTfLiteError;
	}

	g_initialized = true;
	LOG_INF("TFLM interpreters initialized (10-class: silence/unknown/up/down/go/stop/left/right/on/off)");
	return kTfLiteOk;
}

/* -----------------------------------------------------------------------
 * Feature generation
 * ----------------------------------------------------------------------- */
static TfLiteStatus generate_single_feature(const int16_t *audio_data,
					    int audio_data_size,
					    int8_t *feature_output)
{
	TfLiteTensor *input =
		g_audio_preprocessor_interpreter->input(0);
	if (!input) {
		return kTfLiteError;
	}
	if (audio_data_size != kAudioSampleDurationCount) {
		LOG_ERR("Feature window size mismatch: %d vs %d",
			audio_data_size, kAudioSampleDurationCount);
		return kTfLiteError;
	}

	TfLiteTensor *output =
		g_audio_preprocessor_interpreter->output(0);
	if (!output) {
		return kTfLiteError;
	}

	std::copy_n(audio_data, audio_data_size,
		    tflite::GetTensorData<int16_t>(input));

	if (g_audio_preprocessor_interpreter->Invoke() != kTfLiteOk) {
		LOG_ERR("Audio preprocessor invoke failed");
		return kTfLiteError;
	}

#if defined(MICRO_SPEECH_FLOAT_PREPROCESSOR)
	{
		const float *f = tflite::GetTensorData<float>(output);
		TfLiteTensor *cls_in = g_micro_speech_interpreter->input(0);
		const float scale      = cls_in->params.scale;
		const int   zero_point = cls_in->params.zero_point;

		for (int i = 0; i < kFeatureSize; i++) {
			int32_t q = static_cast<int32_t>(roundf(f[i] / scale))
				    + zero_point;
			q = std::max(-128, std::min(127, q));
			feature_output[i] = static_cast<int8_t>(q);
		}
	}
#else
	std::copy_n(tflite::GetTensorData<int8_t>(output),
		    kFeatureSize, feature_output);
#endif
	return kTfLiteOk;
}

static TfLiteStatus generate_features(const int16_t *audio_data,
				      size_t audio_data_size,
				      Features *features_output)
{
	memset(features_output, 0, sizeof(Features));

	size_t remaining   = audio_data_size;
	size_t feature_idx = 0;
	const int16_t *ptr = audio_data;

	while (remaining >= (size_t)kAudioSampleDurationCount &&
	       feature_idx < kFeatureCount) {
		if (generate_single_feature(ptr, kAudioSampleDurationCount,
					    (*features_output)[feature_idx])
		    != kTfLiteOk) {
			LOG_ERR("Feature %zu generation failed", feature_idx);
			return kTfLiteError;
		}
		feature_idx++;
		ptr       += kAudioSampleStrideCount;
		remaining -= kAudioSampleStrideCount;
	}

	return kTfLiteOk;
}

/* -----------------------------------------------------------------------
 * Inference
 * ----------------------------------------------------------------------- */
static TfLiteStatus run_inference(const Features &features)
{
	TfLiteTensor *input  = g_micro_speech_interpreter->input(0);
	TfLiteTensor *output = g_micro_speech_interpreter->output(0);

	if (!input || !output) {
		return kTfLiteError;
	}
	if (output->dims->data[output->dims->size - 1] != kCategoryCount) {
		LOG_ERR("Output tensor size mismatch: got %d, want %d",
			output->dims->data[output->dims->size - 1],
			kCategoryCount);
		return kTfLiteError;
	}

	std::copy_n(&features[0][0], kFeatureElementCount,
		    tflite::GetTensorData<int8_t>(input));

	int64_t t_infer = k_uptime_get();
	if (g_micro_speech_interpreter->Invoke() != kTfLiteOk) {
		LOG_ERR("tiny_conv_v4 invoke failed");
		return kTfLiteError;
	}
	int64_t infer_ms = k_uptime_delta(&t_infer);

	float output_scale      = output->params.scale;
	int   output_zero_point = output->params.zero_point;

	float scores[kCategoryCount];
	const int8_t *raw = tflite::GetTensorData<int8_t>(output);

	for (int i = 0; i < kCategoryCount; i++) {
		scores[i] = (raw[i] - output_zero_point) * output_scale;
	}

	int best = (int)(std::max_element(scores, scores + kCategoryCount) -
			 scores);
	LOG_INF("Detected: %s (%.2f) [infer %lld ms]", kCategoryLabels[best],
		(double)scores[best], infer_ms);
	/* Debug: dump all class scores to find correct label order */
	for (int i = 0; i < kCategoryCount; i++) {
		LOG_INF("  [%d] %s = %.3f", i, kCategoryLabels[i], (double)scores[i]);
	}

	return kTfLiteOk;
}

} /* namespace */

/* -----------------------------------------------------------------------
 * Public C API
 * ----------------------------------------------------------------------- */
extern "C" {

void model_runner_init(void)
{
	if (initialize_interpreters() != kTfLiteOk) {
		LOG_ERR("Failed to initialize TFLM interpreters");
	}
}

int micro_speech_process_audio(const int16_t *audio_data,
			       size_t audio_data_size)
{
	int64_t t_feat = k_uptime_get();
	if (generate_features(audio_data, audio_data_size,
			      &g_features) != kTfLiteOk) {
		LOG_ERR("Feature generation failed");
		return -1;
	}
	int64_t feat_ms = k_uptime_delta(&t_feat);
	LOG_INF("Feature gen: %lld ms (%d windows)", feat_ms, kFeatureCount);

	if (run_inference(g_features) != kTfLiteOk) {
		LOG_ERR("Inference failed");
		return -2;
	}
	return 0;
}

} /* extern "C" */
```

## src/tiny_conv_v4_model.hpp
```c
/*
 * SPDX-License-Identifier: Apache-2.0
 *
 * tiny_conv_v4 INT8 quantized classifier — 10-class keyword spotter.
 * Trained on Speech Commands v2: silence, unknown, down, go, left,
 * off, on, right, stop, up.
 * Input:  [1, 49, 40, 1] INT8   (49 MFSC frames × 40 bins)
 * Output: [1, 10]        INT8   (class logits with softmax)
 */

#ifndef MICRO_SPEECH_XIAO_V4_TINY_CONV_V4_MODEL_H_
#define MICRO_SPEECH_XIAO_V4_TINY_CONV_V4_MODEL_H_

extern const unsigned char g_tiny_conv_v4_model[];
extern const unsigned int  g_tiny_conv_v4_model_len;

#endif /* MICRO_SPEECH_XIAO_V4_TINY_CONV_V4_MODEL_H_ */
```
